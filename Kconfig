## Kconfig
```kconfig
config BATTERY_ALERT
    bool "Enable Battery Low Alert"
    default y

config BATTERY_LEVEL
    int "Battery Alert Threshold (%)"
    default 5
    range 0 100
    depends on BATTERY_ALERT

config RECORD_LAYER
    bool "Record last used layer to flash"
    default y
    depends on SETTINGS

config XW12A
	bool "XW12A capacitive touch sensor"
	default y
	depends on DT_HAS_XINWANG_XW12A_ENABLED
	select I2C
```

## Kconfig.board
```kconfig
# touchtype board configuration

# Copyright (c) 2020 The ZMK Contributors
# SPDX-License-Identifier: MIT

config BOARD_TOUCHTYPE
	bool "touchtype"
	depends on SOC_NRF52832_QFAA
```

## Kconfig.defconfig
```kconfig
# touchtype board configuration
# 不影响蓝牙开关与否

if BOARD_TOUCHTYPE

config BOARD
	default "touchtype"

config BT_CTLR
	default BT

config ZMK_KEYBOARD_NAME
    default "touchModule"

config ZMK_KSCAN_MATRIX_POLLING
    default yCONFIG_SOC_NRF52832_QFA=y

endif # BOARD_TOUCHTYPE
```

## touchtype_defconfig
```kconfig
###### 以下是用户可以自定义的固件选项 #####

# 键盘默认名称
CONFIG_ZMK_KEYBOARD_NAME="TypeMax"

# 进入空闲模式的等待时间阀值，单位是毫秒，默认是 30000 毫秒，也就是 30 秒
CONFIG_ZMK_IDLE_TIMEOUT=30000

# 启用深度睡眠功能之后，第一次点击按键是唤醒键盘，第二次点击键盘才是点击按键，启用此功能可以大幅度延长键盘待机时长
CONFIG_ZMK_SLEEP=y

# 进入睡眠模式的等待时间阀值，单位是毫秒，默认是 900000 毫秒，也就是 15 分钟
CONFIG_ZMK_IDLE_SLEEP_TIMEOUT=60000

# 电池低于某个阀值的时候，红色 led 会闪烁提示，建议启用
CONFIG_BATTERY_ALERT=y

# 电池容量警告提示的电池容量百分比阀值，默认值 5，也就是电池电量低于 5% 的时候会亮红灯闪烁警告
CONFIG_BATTERY_LEVEL=5

# 启用层记录功能。关闭的话每次唤醒之后会回到默认层；启用后可以回到上一次切换的层
# 需要注意的是，层记录功能会刷写芯片 flash，会影响到芯片寿命
# 但是只要你不频繁切换层的话，其实这个影响很小，正常使用基本可以保证芯片至少八年寿命，所以建议开启
CONFIG_RECORD_LAYER=y







###### 除非你很熟悉 zmk，否则以下选项不要碰 #####

CONFIG_BOARD_TOUCHTYPE=y
CONFIG_SOC_SERIES_NRF52X=y
CONFIG_SOC_NRF52832_QFAA=y

# enable GPIO
CONFIG_GPIO=y

# Enable i2c
CONFIG_I2C=y

# Enable MPU
CONFIG_ARM_MPU=y

# 启用 zmk 蓝牙功能，这是核心功能，必须开启
CONFIG_ZMK_BLE=y

# board板没有 DCDC 电感元件，则需要删除 Kconfig 文件并注释掉以下这行
# 后期如果修改电路，启用 DCDC 电源，则可以启用这个设置
#CONFIG_BOARD_ENABLE_DCDC=n

# 硬件设定为外围设备，键盘对于主机是外围设置，这是必选项
CONFIG_BT_PERIPHERAL=y



# 与主机连接后，及时向主机发送 zmk 的状态信息，可以简单理解为更快显示电池电量
CONFIG_BT_GATT_ENFORCE_SUBSCRIPTION=n

# 保存配对信息
CONFIG_BT_SMP=y

# 允许设备请求绑定
CONFIG_BT_BONDABLE=y

# 启用蓝牙配置存储到 Flash
CONFIG_BT_SETTINGS=y	

# 最多连接多少个设备，这里其实只能使用 1
CONFIG_BT_MAX_CONN=1

# 最多保存多少个已配对设备，超过会覆盖最老的。这里使用 ← 、↓ 、→ 作为切换槽位的按键,这里的数量会影响电量功耗
CONFIG_BT_MAX_PAIRED=3





#### 电池电量管理相关 #######

# ADC 驱动
CONFIG_ADC_NRFX_SAADC=y

# 启用 ADC
CONFIG_ADC=y

# 启用电池服务 (BLE)
CONFIG_BT_BAS=y
CONFIG_ZMK_BATTERY_REPORTING=y

# 设置电量报告间隔为 120 秒 (2 分钟)
CONFIG_ZMK_BATTERY_REPORT_INTERVAL=120

# 进入深度睡眠模式之后，关闭I2C、SPI、UART等接口用于省电
# 如果后续的XW12A芯片无法正常工作，可以尝试停用该功能
CONFIG_PM_DEVICE=y








# 具体作用我也不知道，但启用它们之后，才能实现 zmk 键盘断电再通电之后直接连接主机
CONFIG_MPU_ALLOW_FLASH_WRITE=y
CONFIG_NVS=y
CONFIG_SETTINGS_NVS=y
CONFIG_FLASH=y
CONFIG_FLASH_PAGE_LAYOUT=y
CONFIG_FLASH_MAP=y





#### 如果在 window 当中无法正常工作，就需要研究一下以下选项，这是 GPT 给出的 ####
# --- Enable BLE & bonding ---
#CONFIG_BT=y
#CONFIG_SETTINGS=y
#CONFIG_SETTINGS_DYNAMIC_HANDLERS=y

# --- Improve Windows compatibility ---
#CONFIG_BT_CTLR_CONN_TIMES=y
#CONFIG_BT_CTLR_CONN_EVENT_LEN_DEFAULT=10
#CONFIG_BT_BUF_ACL_RX_COUNT=7
#CONFIG_BT_BUF_ACL_RX_SIZE=251
#CONFIG_BT_HCI_ACL_FLOW_CONTROL=y

# --- Linux + Android + macOS optimizations ---
#CONFIG_BT_L2CAP_TX_MTU=247
#CONFIG_BT_BUF_ACL_TX_COUNT=7
#CONFIG_BT_BUF_ACL_TX_SIZE=251
#CONFIG_BT_ATT_PREPARE_COUNT=5
#CONFIG_BT_GATT_CLIENT=y

# --- Advertising improvements ---
#CONFIG_BT_DEVICE_APPEARANCE=961
#CONFIG_BT_SCAN_WITH_IDENTITY=y

# --- NRF52 stabilizer ---
#CONFIG_BT_CTLR_SDC_FIX=y
#CONFIG_BT_LL_SW_SPLIT=y



# 启用 Zephyr 核心设置和 Flash 驱动
CONFIG_SETTINGS=y


# XW12A 触摸芯片相关驱动
CONFIG_I2C=y
CONFIG_XW12A=y
```
